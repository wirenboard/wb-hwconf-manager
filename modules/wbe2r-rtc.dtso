/*
 * Copyright 2022 Contactless Devices, LLC.
 *
 * The code contained herein is licensed under the GNU General Public
 * License. You may obtain a copy of the GNU General Public License
 * Version 2 or later at the following locations:
 *
 * http://www.opensource.org/licenses/gpl-license.html
 * http://www.gnu.org/copyleft/gpl.html
 */

/ {
	description = "WBE2-R-RTC: Temp-compensated Real Time Clock module";
	compatible-slots = "wbe3-reduced";

	#include "wbe2-i2c.dtsi"

	fragment_rtc_off {
		target = <&rtc_onboard>;

		__overlay__ {
			status = "disabled";
		};
	};

	fragment_mod_rtc_on {
		target-path = "/";

		__overlay__ {
			SLOT_DT_ALIAS(i2c) {
				compatible = "i2c-gpio";
				gpios = <SLOT_GPIO(TX)
					 SLOT_GPIO(RX)
					>;
				i2c-gpio,delay-us = <20>;	   /* ~100 kHz */

				pinctrl-names = "default";
				pinctrl-0 = <SLOT_TXRX_GPIO_PINCTRL
					     SLOT_DE_GPIO_PINCTRL
					    >;

				status = "okay";

				__address-cells = <1>;
				__size-cells = <0>;

				SLOT_DT_ALIAS(rtc)@32 {
					compatible = "microcrystal,rv8803";
					reg = <0x32>;
				};
			};
		};
	};
};
