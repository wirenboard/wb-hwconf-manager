/*
 * Copyright 2016 Contactless Devices, LLC.
 *
 * The code contained herein is licensed under the GNU General Public
 * License. You may obtain a copy of the GNU General Public License
 * Version 2 or later at the following locations:
 *
 * http://www.opensource.org/licenses/gpl-license.html
 * http://www.gnu.org/copyleft/gpl.html
 */

/ {
	description = "WBE2-I-RS485-ISO: Isolated RS-485 interface module";
	compatible-slots = "wbe2";

    fragment@0 {
        target = <SLOT_UART_ALIAS>;

        __overlay__ {
            status = "okay";
            pinctrl-names = "default";
            pinctrl-0 = <SLOT_TXRX_UART_PINCTRL SLOT_DE_UART_PINCTRL>;
            rts-gpios = <SLOT_RTS_GPIOS>;

            linux,rs485-enabled-at-boot-time;
        };
    };
};
