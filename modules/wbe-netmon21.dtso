/*
 * Copyright 2016 Contactless Devices, LLC.
 *
 * The code contained herein is licensed under the GNU General Public
 * License. You may obtain a copy of the GNU General Public License
 * Version 2 or later at the following locations:
 *
 * http://www.opensource.org/licenses/gpl-license.html
 * http://www.gnu.org/copyleft/gpl.html
 */

/ {
	description = "Temperature and humidity sensor and status LED for Wiren Board NETMON-2 r.1";
	compatible-slots = "wb5-mod";

	#include "wbe-i2c.dtsi"

    fragment@1 {
        target = <SLOT_UART_ALIAS>;

        __overlay__ {
            status = "disabled";
        };
    };

    fragment@2 {
        target-path = "/";

        __overlay__ {
            leds-netmon {
                compatible = "gpio-leds";
                pinctrl-names = "default";
                pinctrl-0 = <SLOT_UART_GPIO_PINCTRL>;

                extgreen {
                    label = "extgreen";
                    gpios = <SLOT_GPIO(TX)>;
                    linux,default-trigger = "timer";
                };
            };
        };
    };

};
