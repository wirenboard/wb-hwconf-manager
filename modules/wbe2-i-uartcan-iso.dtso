/*
 * Copyright 2016 Contactless Devices, LLC.
 *
 * The code contained herein is licensed under the GNU General Public
 * License. You may obtain a copy of the GNU General Public License
 * Version 2 or later at the following locations:
 *
 * http://www.opensource.org/licenses/gpl-license.html
 * http://www.gnu.org/copyleft/gpl.html
 */

/ {
	description = "WBE2-I-UARTCAN-ISO: Isolated UART-CAN interface module";
	compatible-slots = "wbe2";

    fragment@0 {
        target = <SLOT_UART_ALIAS>;

        __overlay__ {
            status = "okay";
            pinctrl-names = "default";
            pinctrl-0 = <SLOT_TXRX_UART_PINCTRL>;
            rts-gpios = <SLOT_GPIO(RTS)>;

            /* TODO: This suppresses local echo by disabling RX during 
            TX. The local echo could be useful in some cases.
            Consider making it configurable */

            linux,rs485-enabled-at-boot-time;
        };
    };
};
