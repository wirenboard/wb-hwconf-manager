/*
 * Copyright 2016 Contactless Devices, LLC.
 *
 * The code contained herein is licensed under the GNU General Public
 * License. You may obtain a copy of the GNU General Public License
 * Version 2 or later at the following locations:
 *
 * http://www.opensource.org/licenses/gpl-license.html
 * http://www.gnu.org/copyleft/gpl.html
 */

/ {
	description = "WBIO-DI-DR-8: Digital inputs (dry contact) I/O module";
	compatible-slots = "wb5-extio";
	
	#define WBIO_NAME wbio_di_dr_8
	#define WBIO_INPUT
	#define GPIO_LINE_NAMES \
			EXTIO_LINE_NAME(DR1), \
			EXTIO_LINE_NAME(DR2), \
			EXTIO_LINE_NAME(DR3), \
			EXTIO_LINE_NAME(DR4), \
			EXTIO_LINE_NAME(DR5), \
			EXTIO_LINE_NAME(DR6), \
			EXTIO_LINE_NAME(DR7), \
			EXTIO_LINE_NAME(DR8)

	#include "wbio.dtsi"

	fragment-gpio {
		target-path = "/wirenboard/gpios";

		__overlay__ {
			EXTIO_INPUT(DR1, 0, 01);
			EXTIO_INPUT(DR2, 1, 02);
			EXTIO_INPUT(DR3, 2, 03);
			EXTIO_INPUT(DR4, 3, 04);
			EXTIO_INPUT(DR5, 4, 05);
			EXTIO_INPUT(DR6, 5, 06);
			EXTIO_INPUT(DR7, 6, 07);
			EXTIO_INPUT(DR8, 7, 08);
		};
	};
};
