/*
 * Copyright 2016 Contactless Devices, LLC.
 *
 * The code contained herein is licensed under the GNU General Public
 * License. You may obtain a copy of the GNU General Public License
 * Version 2 or later at the following locations:
 *
 * http://www.opensource.org/licenses/gpl-license.html
 * http://www.gnu.org/copyleft/gpl.html
 */

/ {
	description = "WBE2S-R-433MHZ radio module";
	compatible-slots = "wbe3";

	fragment_uart_off {
		target = <SLOT_UART_ALIAS>;

		__overlay__ {
			status = "disabled";
		};
	};

	fragment_add_spi_dev {
		target = <SLOT_SPI_ALIAS>;

		__overlay__ {
			status = "okay";
			pinctrl-names = "default";
			pinctrl-0 = <SLOT_SPI_SPI_PINCTRL>;

			spidev@0 {
				compatible = "hoperf,rfm69w";
				spi-max-frequency = <100000>;
				reg = <0>;
			};
		};
	};

	fragment_add_lirc {
		target-path = "/";

		__overlay__ {
			lirc-rfm69-mod3 {
				compatible = "lirc-pwm";

				pinctrl-names = "default";
				pinctrl-0 = <SLOT_TXRX_GPIO_PINCTRL>;

				gpio-recv = <SLOT_GPIO(TX)>;
				gpio-recv-disable-filter;
			};
		};
	};

	fragment_change_wb_env {
		target-path = "/wirenboard/radio";

		__overlay__ {
			irq-gpios = <SLOT_GPIO(RTS)>;
			dio2-gpios = <SLOT_GPIO(TX)>;
			spi-device = <&{/fragment_add_spi_dev/__overlay__/spidev@0}>;
			lirc-device = <&{/fragment_add_lirc/__overlay__/lirc-rfm69-mod3}>;
		};
	};
};
