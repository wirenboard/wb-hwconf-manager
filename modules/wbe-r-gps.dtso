/*
 * Copyright 2016 Contactless Devices, LLC.
 *
 * The code contained herein is licensed under the GNU General Public
 * License. You may obtain a copy of the GNU General Public License
 * Version 2 or later at the following locations:
 *
 * http://www.opensource.org/licenses/gpl-license.html
 * http://www.gnu.org/copyleft/gpl.html
 */

/ {
	description = "WBE-R-GPS: GPS/GLONASS GNSS extension module";
	compatible-slots = "wb5-mod";


    fragment@0 {
        target-path = "/";

        __overlay__ {
            SLOT_DT_ALIAS(pps) {
                compatible = "pps-gpio";
                pinctrl-names = "default";
                pinctrl-0 = <SLOT_CS_GPIO_PINCTRL>;

                gpios = <SLOT_GPIO(CS)>;
            };
        };
    };
};
