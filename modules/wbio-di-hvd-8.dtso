/*
 * Copyright 2016 Contactless Devices, LLC.
 *
 * The code contained herein is licensed under the GNU General Public
 * License. You may obtain a copy of the GNU General Public License
 * Version 2 or later at the following locations:
 *
 * http://www.opensource.org/licenses/gpl-license.html
 * http://www.gnu.org/copyleft/gpl.html
 */

/ {
    description = "WBIO-DI-HVD-8: High Voltage Digital Inputs I/O module";
	compatible-slots = "wb5-extio";
	
	#define WBIO_NAME wbio_di_hvd_8
	#define WBIO_INPUT
	#include "wbio.dtsi"
};
