/*
 * Copyright 2016 Contactless Devices, LLC.
 *
 * The code contained herein is licensed under the GNU General Public
 * License. You may obtain a copy of the GNU General Public License
 * Version 2 or later at the following locations:
 *
 * http://www.opensource.org/licenses/gpl-license.html
 * http://www.gnu.org/copyleft/gpl.html
 */

/ {
	description = "WBIO-DO-SSR-8: Small Signal SSR I/O Module";
	compatible-slots = "wb5-extio";

	#define WBIO_NAME wbio_do_ssr_8
	#define WBIO_OUTPUT
	#define GPIO_LINE_NAMES \
			EXTIO_LINE_NAME(K1), \
			EXTIO_LINE_NAME(K2), \
			EXTIO_LINE_NAME(K3), \
			EXTIO_LINE_NAME(K4), \
			EXTIO_LINE_NAME(K5), \
			EXTIO_LINE_NAME(K6), \
			EXTIO_LINE_NAME(K7), \
			EXTIO_LINE_NAME(K8)

	#include "wbio.dtsi"

	fragment-gpio {
		target-path = "/wirenboard/gpios";

		__overlay__ {
			EXTIO_OUTPUT_HIGH(K1, 0, 01);
			EXTIO_OUTPUT_HIGH(K2, 1, 02);
			EXTIO_OUTPUT_HIGH(K3, 2, 03);
			EXTIO_OUTPUT_HIGH(K4, 3, 04);
			EXTIO_OUTPUT_HIGH(K5, 4, 05);
			EXTIO_OUTPUT_HIGH(K6, 5, 06);
			EXTIO_OUTPUT_HIGH(K7, 6, 07);
			EXTIO_OUTPUT_HIGH(K8, 7, 08);
		};
	};
};
