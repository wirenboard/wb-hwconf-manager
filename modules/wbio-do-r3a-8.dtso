/*
 * Copyright 2016 Contactless Devices, LLC.
 *
 * The code contained herein is licensed under the GNU General Public
 * License. You may obtain a copy of the GNU General Public License
 * Version 2 or later at the following locations:
 *
 * http://www.opensource.org/licenses/gpl-license.html
 * http://www.gnu.org/copyleft/gpl.html
 */

/ {
	description = "WBIO-DO-RxA-8: 8 Channel Relay I/O module";
	compatible-slots = "wb5-extio";
	
	#define WBIO_NAME wbio_do_r3a_8
	#define WBIO_OUTPUT
	#define GPIO_LINE_NAMES \
			EXTIO_LINE_NAME(R3A1), \
			EXTIO_LINE_NAME(R3A2), \
			EXTIO_LINE_NAME(R3A3), \
			EXTIO_LINE_NAME(R3A4), \
			EXTIO_LINE_NAME(R3A5), \
			EXTIO_LINE_NAME(R3A6), \
			EXTIO_LINE_NAME(R3A7), \
			EXTIO_LINE_NAME(R3A8)

	#include "wbio.dtsi"

	fragment-gpio {
		target-path = "/wirenboard/gpios";

		__overlay__ {
			EXTIO_OUTPUT_HIGH(R3A1, 0, 01);
			EXTIO_OUTPUT_HIGH(R3A2, 1, 02);
			EXTIO_OUTPUT_HIGH(R3A3, 2, 03);
			EXTIO_OUTPUT_HIGH(R3A4, 3, 04);
			EXTIO_OUTPUT_HIGH(R3A5, 4, 05);
			EXTIO_OUTPUT_HIGH(R3A6, 5, 06);
			EXTIO_OUTPUT_HIGH(R3A7, 6, 07);
			EXTIO_OUTPUT_HIGH(R3A8, 7, 08);
		};
	};
};
