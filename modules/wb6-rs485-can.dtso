/*
 * Copyright 2017 Contactless Devices, LLC.
 *
 * The code contained herein is licensed under the GNU General Public
 * License. You may obtain a copy of the GNU General Public License
 * Version 2 or later at the following locations:
 *
 * http://www.opensource.org/licenses/gpl-license.html
 * http://www.gnu.org/copyleft/gpl.html
 */

/ {
	description = "CAN interface on RS485-2 terminals for WB6";
	compatible-slots = "wb6-can";

	fragment_off_uart {
		target = <SLOT_UART_ALIAS>;

		__overlay__ {
			status = "disabled";
		};
	};

	fragment_on_can {
		target = <SLOT_CAN_ALIAS>;

		__overlay__ {
			status = "okay";
		};
	};
};
