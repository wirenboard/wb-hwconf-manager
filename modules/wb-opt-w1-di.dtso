/*
 * Copyright 2016 Contactless Devices, LLC.
 *
 * The code contained herein is licensed under the GNU General Public
 * License. You may obtain a copy of the GNU General Public License
 * Version 2 or later at the following locations:
 *
 * http://www.opensource.org/licenses/gpl-license.html
 * http://www.gnu.org/copyleft/gpl.html
 */

/ {
	description = "Discrete Input (For Dry Contact Signal)";
	compatible-slots = "wb-wx-v1";
	compatible = "contactless,imx28-wirenboard52";
    fragment@0 {
        target-path = "/onewire@0";

        __overlay__ {
        	status = "disabled";
        };
    };


};
