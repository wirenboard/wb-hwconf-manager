/*
 * Copyright 2017 Contactless Devices, LLC.
 *
 * The code contained herein is licensed under the GNU General Public
 * License. You may obtain a copy of the GNU General Public License
 * Version 2 or later at the following locations:
 *
 * http://www.opensource.org/licenses/gpl-license.html
 * http://www.gnu.org/copyleft/gpl.html
 */

/ {
	description = "UART-CAN interface on RS485-2 terminals for WB6";
	compatible-slots = "wb6-can";

	fragment_uart_on {
		target = <SLOT_UART_ALIAS>;

		__overlay__ {
			pinctrl-0 = <SLOT_UART_CAN_PINCTRL>;
			uart-has-rtscts = <0>;
			status = "okay";
		};
	};

	fragment_reg{
		target-path = "/";

		__overlay__ {
			SLOT_DT_ALIAS(pinmux_dummy) {
				compatible = "regulator-fixed";
				regulator-name = EXPAND_AND_QUOTE(SLOT_DT_ALIAS(pinmux_dummy));
				regulator-min-microvolt = <5000000>;
				regulator-max-microvolt = <5000000>;
				regulator-boot-on;
				regulator-always-on;
				vin-supply = <SLOT_UART_CAN_REGULATOR>;
			};
		};
	};


	fragment_can_off {
		target = <SLOT_CAN_ALIAS>;

		__overlay__ {
			status = "disabled";
		};
	};
};
