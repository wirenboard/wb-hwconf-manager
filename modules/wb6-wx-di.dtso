/*
 * Copyright 2016 Contactless Devices, LLC.
 *
 * The code contained herein is licensed under the GNU General Public
 * License. You may obtain a copy of the GNU General Public License
 * Version 2 or later at the following locations:
 *
 * http://www.opensource.org/licenses/gpl-license.html
 * http://www.gnu.org/copyleft/gpl.html
 */

/ {
	description = "Discrete input";
	compatible-slots = "wb6-wx";

    fragment_w1_off {
        target = <SLOT_1WIRE_ALIAS>;

        __overlay__ {
            status = "disabled";
        };
    };

    fragment_di_on {
        target-path = "/";

        __overlay__ {
            SLOT_DT_ALIAS(reg_pu_dummy) {
                compatible = "regulator-fixed";
                regulator-name = EXPAND_AND_QUOTE(SLOT_DT_ALIAS(reg_pu_dummy));

                pinctrl-names = "default";
                pinctrl-0 = <SLOT_PINCTRL>;

                gpio = <SLOT_GPIO(PULLUP)>;
                enable-active-high;
            };
        };
    };

	fragment-gpio {
		target-path = "/wirenboard/gpios";

		__overlay__ {
			__cat4(W, W_SLOT_NUM, _, IN) {
				io-gpios = <SLOT_GPIO_LOW(DATA)>;
                gpio-xlate-type = SLOT_GPIO_XLATE_TYPE(DATA);
                gpio-pins-per-bank = <SLOT_GPIO_PINS_PER_BANK(DATA)>;
				input;
				sort-order = <__cat(W_SLOT_NUM, 001)>;
			};
		};
	};
};
