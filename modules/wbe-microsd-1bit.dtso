/*
 * Copyright 2016 Contactless Devices, LLC.
 *
 * The code contained herein is licensed under the GNU General Public
 * License. You may obtain a copy of the GNU General Public License
 * Version 2 or later at the following locations:
 *
 * http://www.opensource.org/licenses/gpl-license.html
 * http://www.gnu.org/copyleft/gpl.html
 */

/ {
	description = "WBE-MICROSD: microSD module (WB 5.6)";
	compatible-slots = "wb5-mod";
	compatible = "contactless,imx28-wirenboard52";

	fragment@0 {
		target = <SLOT_SSP_ALIAS>;

		__overlay__ {
			compatible = "fsl,imx28-mmc";
			pinctrl-names = "default";
			pinctrl-0 = <SLOT_SPI_PINCTRL>;
			bus-width = <1>;
			status = "okay";
			broken-cd;
		};
	};
};
