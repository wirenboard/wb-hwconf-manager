/*
 * Copyright (c) 2025 Contactless Devices, LLC (Wiren Board)
 *
 * The code contained herein is licensed under the GNU General Public
 * License. You may obtain a copy of the GNU General Public License
 * Version 2 or later at the following locations:
 *
 * http://www.opensource.org/licenses/gpl-license.html
 * http://www.gnu.org/copyleft/gpl.html
 */

/ {
    description = "WBE2-HDMI: HDMI interface";
    compatible-slots = "wbe2-hdmi";

    /* HDMI is enabled statically in the base DTS; this .dtso is a dummy overlay for UI metadata. */
    /* The wb-overlay-meta node under "/" creates a non-empty changeset and prevents WARNs on overlay removal. */
    fragment@0 {
        target-path = "/";
        __overlay__ {
            wb-hdmi-overlay-dummy {
                status = "okay";
                overlay-id = "wbe2-hdmi-dummy";
            };
        };
    };
};

