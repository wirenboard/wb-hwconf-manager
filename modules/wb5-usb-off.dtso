/*
 * Copyright 2016 Contactless Devices, LLC.
 *
 * The code contained herein is licensed under the GNU General Public
 * License. You may obtain a copy of the GNU General Public License
 * Version 2 or later at the following locations:
 *
 * http://www.opensource.org/licenses/gpl-license.html
 * http://www.gnu.org/copyleft/gpl.html
 */

/ {
	description = "usb off";
	compatible-slots = "wb5-usb";
	compatible = "contactless,imx28-wirenboard55";


    fragment@0 {
        target = <&usb0>;

        __overlay__ {
            status = "disabled";
        };
    };

};
