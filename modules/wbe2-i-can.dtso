/*
 * Copyright 2025 Contactless Devices, LLC.
 *
 * The code contained herein is licensed under the GNU General Public
 * License. You may obtain a copy of the GNU General Public License
 * Version 2 or later at the following locations:
 *
 * http://www.opensource.org/licenses/gpl-license.html
 * http://www.gnu.org/copyleft/gpl.html
 */

/ {
	description = "WBE2-I-CAN: Isolated CAN interface module";
	compatible-slots = "wbe2-i-can";

	fragment@0 {
		target = <SLOT_UART_ALIAS>;

		__overlay__ {
			status = "okay";

			can@0 {
				compatible = "holtek,ht42b416";
				current-speed = <115200>;
			};
		};
	};

	fragment-pinctrl {
		target-path = "/";

		__overlay__ {
			SLOT_DT_ALIAS(pinmux_dummy) {
				compatible = "regulator-fixed";
				regulator-name = EXPAND_AND_QUOTE(SLOT_DT_ALIAS(pinmux_dummy));

				pinctrl-names = "default";
				pinctrl-0 = <SLOT_DE_GPIO_PINCTRL>;
			};
		};
	};

	fragment-gpio { // new dummy gpios node to keep wb-mqtt-gpio calm
		target-path = "/wirenboard";

		__overlay__ {
			gpios-__cat(mod, MOD_SLOT_NUM) {
				WBE_OUTPUT_HIGH(OUT1, RTS, 1);
			};
		};
	};
};
