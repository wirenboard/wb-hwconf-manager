/*
 * Copyright 2021 Contactless Devices, LLC.
 *
 * The code contained herein is licensed under the GNU General Public
 * License. You may obtain a copy of the GNU General Public License
 * Version 2 or later at the following locations:
 *
 * http://www.opensource.org/licenses/gpl-license.html
 * http://www.gnu.org/copyleft/gpl.html
 */

/ {
	description = "WBE2-I-EBUS: eBus Boiler Interface";
	compatible-slots = "wbe2";
	#include "wbe2-uart.dtsi"
};
