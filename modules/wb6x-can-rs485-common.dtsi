/*
 * Copyright 2020 Contactless Devices, LLC.
 *
 * The code contained herein is licensed under the GNU General Public
 * License. You may obtain a copy of the GNU General Public License
 * Version 2 or later at the following locations:
 *
 * http://www.opensource.org/licenses/gpl-license.html
 * http://www.gnu.org/copyleft/gpl.html
 */

#if defined (SLOT_HAS_CAN)
fragment_can_off {
	target = <SLOT_CAN_ALIAS>;

	__overlay__ {
		status = "disabled";
	};
};
#endif

fragment_uart_on {
	target = <SLOT_UART_ALIAS>;

	__overlay__ {
		pinctrl-0 = <SLOT_UART_RS485_PINCTRL>;
		status = "okay";
	};
};
