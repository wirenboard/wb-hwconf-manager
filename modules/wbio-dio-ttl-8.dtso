/*
 * Copyright 2016 Contactless Devices, LLC.
 *
 * The code contained herein is licensed under the GNU General Public
 * License. You may obtain a copy of the GNU General Public License
 * Version 2 or later at the following locations:
 *
 * http://www.opensource.org/licenses/gpl-license.html
 * http://www.gnu.org/copyleft/gpl.html
 */

/ {
	description = "WBIO-DIO-TTL-8: TTL GPIO I/O module";
	compatible-slots = "wb5-extio";
	
	#define WBIO_NAME wbio_dio_ttl_8
	#define WBIO_OUTPUT
	#define GPIO_LINE_NAMES \
			EXTIO_LINE_NAME(TTL1), \
			EXTIO_LINE_NAME(TTL2), \
			EXTIO_LINE_NAME(TTL3), \
			EXTIO_LINE_NAME(TTL4), \
			EXTIO_LINE_NAME(TTL5), \
			EXTIO_LINE_NAME(TTL6), \
			EXTIO_LINE_NAME(TTL7), \
			EXTIO_LINE_NAME(TTL8)

	#include "wbio.dtsi"

	fragment-gpio {
		target-path = "/wirenboard/gpios";

		__overlay__ {
			EXTIO_OUTPUT_HIGH(TTL1, 0, 01);
			EXTIO_OUTPUT_HIGH(TTL2, 1, 02);
			EXTIO_OUTPUT_HIGH(TTL3, 2, 03);
			EXTIO_OUTPUT_HIGH(TTL4, 3, 04);
			EXTIO_OUTPUT_HIGH(TTL5, 4, 05);
			EXTIO_OUTPUT_HIGH(TTL6, 5, 06);
			EXTIO_OUTPUT_HIGH(TTL7, 6, 07);
			EXTIO_OUTPUT_HIGH(TTL8, 7, 08);
		};
	};
};
