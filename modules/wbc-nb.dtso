/*
 * Copyright 2020 Contactless Devices, LLC.
 *
 * The code contained herein is licensed under the GNU General Public
 * License. You may obtain a copy of the GNU General Public License
 * Version 2 or later at the following locations:
 *
 * http://www.opensource.org/licenses/gpl-license.html
 * http://www.gnu.org/copyleft/gpl.html
 */

/ {
    description = "WBC-NB: NB-IoT + eMTC + 2G Modem";
    compatible-slots = "wbc";

    fragment_enable_uart {
        target = <SLOT_UART_ALIAS>;

        __overlay__ {
            status = "okay";
        };
    };

    fragment_change_wb_env {
        target = <&wbc_modem>;

        __overlay__ {
            status = "okay";
            model = "sim7000e";
            type = "nb-iot", "emtc", "edge", "gprs";
            compatible = "wirenboard,wbc-usb";
        };
    };
};
