#ifdef WBIO_INPUT
#define SLOT_I2C_ADDRESS SLOT_I2C_ADDRESS_IN
#endif

#ifdef WBIO_OUTPUT
#define SLOT_I2C_ADDRESS SLOT_I2C_ADDRESS_OUT
#endif
fragment@0 {
	target = <SLOT_I2C_ALIAS>;

	__overlay__ {
		__address-cells = <1>;
		__size-cells = <0>;

		SLOT_DT_ALIAS(WBIO_NAME): gpio@SLOT_I2C_ADDRESS {
			compatible = "microchip,mcp23017";
			gpio-controller;
			__gpio-cells = <2>;
			reg = <HEX_PREFIX(SLOT_I2C_ADDRESS)>;

			microchip,irq-open-drain;
			microchip,irq-mirror;

			interrupt-parent = <SLOT_GPIO_PORT_ALIAS(INT)>;
			interrupts = <SLOT_GPIO_PIN(INT) IRQ_TYPE_LEVEL_LOW>;
			interrupt-controller;
			__interrupt-cells=<2>;

			linux,gpio-base = <SLOT_GPIO_BASE_40>;
		};
	};
};

