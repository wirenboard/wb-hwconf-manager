/*
 * Copyright 2016 Contactless Devices, LLC.
 *
 * The code contained herein is licensed under the GNU General Public
 * License. You may obtain a copy of the GNU General Public License
 * Version 2 or later at the following locations:
 *
 * http://www.opensource.org/licenses/gpl-license.html
 * http://www.gnu.org/copyleft/gpl.html
 */

/ {
    description = "WBIO-AI-DV-12 Analog Inputs";
    compatible-slots = "wb5-extio";

    fragment@0 {
        target = <SLOT_I2C_ALIAS>;

        __overlay__ {
            __address-cells = <1>;
            __size-cells = <0>;

            SLOT_DT_ALIAS(aidv12_1)@48 {
                compatible = "ti,ads1115";
                reg = <0x48>;
                __address-cells = <1>;
                __size-cells = <0>;
            };

            SLOT_DT_ALIAS(aidv12_2)@49 {
                compatible = "ti,ads1115";
                reg = <0x49>;
                __address-cells = <1>;
                __size-cells = <0>;
            };
            SLOT_DT_ALIAS(aidv12_3)@4a {
                compatible = "ti,ads1115";
                reg = <0x4a>;
                __address-cells = <1>;
                __size-cells = <0>;
            };
        };
    };
};
