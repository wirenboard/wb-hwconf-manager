/*
 * Copyright 2016 Contactless Devices, LLC.
 *
 * The code contained herein is licensed under the GNU General Public
 * License. You may obtain a copy of the GNU General Public License
 * Version 2 or later at the following locations:
 *
 * http://www.opensource.org/licenses/gpl-license.html
 * http://www.gnu.org/copyleft/gpl.html
 */

/ {
	description = "WBE-DO-SSR-2: Dual Small Signal SSR Module";
	compatible-slots = "wb5-mod";
	compatible = "contactless,imx28-wirenboard52";

    fragment@0 {
        target = <SLOT_UART_ALIAS>;

        __overlay__ {
            status = "disabled";
        };
    };


    fragment@1 {
        target-path = "/";

        __overlay__ {
            SLOT_DT_ALIAS(pimux_dummy): SLOT_DT_ALIAS(pimux_dummy)@0 {
                compatible = "regulator-fixed";
                regulator-name = EXPAND_AND_QUOTE(SLOT_DT_ALIAS(pimux_dummy));

                pinctrl-names = "default";
                pinctrl-0 = <SLOT_CS_GPIO_PINCTRL
                             SLOT_UART_GPIO_PINCTRL>;
            };
        };
    };

};
