/*
 * Copyright 2016 Contactless Devices, LLC.
 *
 * The code contained herein is licensed under the GNU General Public
 * License. You may obtain a copy of the GNU General Public License
 * Version 2 or later at the following locations:
 *
 * http://www.opensource.org/licenses/gpl-license.html
 * http://www.gnu.org/copyleft/gpl.html
 */

/ {
	description = "WBE-I-W1: 1-Wire interface module";
	compatible-slots = "wb5-mod";
	compatible = "contactless,imx28-wirenboard52";

	fragment@1 {
		target-path = "/";

		__overlay__ {
			SLOT_DT_ALIAS(onewire): SLOT_DT_ALIAS(onewire)@0 {
				compatible = "w1-gpio";
				pinctrl-names = "default";
				pinctrl-0 = <SLOT_I2C_PINCTRL SLOT_CS_GPIO_PINCTRL>;
				gpios = <SLOT_GPIO(SDA)>;
				pu-gpios = <SLOT_GPIO(SCL)>;
			};
		};
	};
};
