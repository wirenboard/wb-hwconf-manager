/*
 * Copyright 2016 Contactless Devices, LLC.
 *
 * The code contained herein is licensed under the GNU General Public
 * License. You may obtain a copy of the GNU General Public License
 * Version 2 or later at the following locations:
 *
 * http://www.opensource.org/licenses/gpl-license.html
 * http://www.gnu.org/copyleft/gpl.html
 */

/ {
	description = "WBE-I-CAN-ISO: Isolated CAN interface module";
	compatible-slots = "wb5-mod_can";
	compatible = "contactless,imx28-wirenboard52";

	fragment@0 {
		target = <SLOT_UART_ALIAS>;

		__overlay__ {
			status = "disabled";
		};
	};

	fragment@1 {
		target = <SLOT_CAN_ALIAS>;

		__overlay__ {
				pinctrl-names = "default";
				pinctrl-0 = <SLOT_CAN_PINCTRL>;
				status = "okay";
		};

	};
};
