/*
 * Copyright 2020 Contactless Devices, LLC.
 *
 * The code contained herein is licensed under the GNU General Public
 * License. You may obtain a copy of the GNU General Public License
 * Version 2 or later at the following locations:
 *
 * http://www.opensource.org/licenses/gpl-license.html
 * http://www.gnu.org/copyleft/gpl.html
 */

/ {
	description = "Expose SPI (DIY): only SPI port";
	compatible-slots = "wbe3";

	fragment {
		target = <SLOT_SPI_ALIAS>;

		__overlay__ {
			status = "okay";
			pinctrl-names = "default";
			pinctrl-0 = <SLOT_SPI_SPI_PINCTRL>;

			spi@ {
				compatible = "spidev";
				spi-max-frequency = <20000000>;
				voltage-ranges = <3200 3400>;
				reg = <0>;
			};
		};
	};
};
