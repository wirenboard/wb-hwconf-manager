/*
 * Copyright 2016-2018 Contactless Devices, LLC.
 *
 * The code contained herein is licensed under the GNU General Public
 * License. You may obtain a copy of the GNU General Public License
 * Version 2 or later at the following locations:
 *
 * http://www.opensource.org/licenses/gpl-license.html
 * http://www.gnu.org/copyleft/gpl.html
 */

/ {
    description = "WBIO-DI-LVD-8: Low Voltage Digital Inputs I/O module";
	compatible-slots = "wb5-extio";
	
	#define WBIO_NAME wbio_di_lvd_8
	#define WBIO_INPUT
	#define GPIO_LINE_NAMES \
			EXTIO_LINE_NAME(IN1), \
			EXTIO_LINE_NAME(IN2), \
			EXTIO_LINE_NAME(IN3), \
			EXTIO_LINE_NAME(IN4), \
			EXTIO_LINE_NAME(IN5), \
			EXTIO_LINE_NAME(IN6), \
			EXTIO_LINE_NAME(IN7), \
			EXTIO_LINE_NAME(IN8)

	#include "wbio.dtsi"

	fragment-gpio {
		target-path = "/wirenboard/gpios";

		__overlay__ {
			EXTIO_INPUT(IN1, 0, 01);
			EXTIO_INPUT(IN2, 1, 02);
			EXTIO_INPUT(IN3, 2, 03);
			EXTIO_INPUT(IN4, 3, 04);
			EXTIO_INPUT(IN5, 4, 05);
			EXTIO_INPUT(IN6, 5, 06);
			EXTIO_INPUT(IN7, 6, 07);
			EXTIO_INPUT(IN8, 7, 08);
		};
	};
};
