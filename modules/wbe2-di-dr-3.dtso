/*
 * Copyright 2016 Contactless Devices, LLC.
 *
 * The code contained herein is licensed under the GNU General Public
 * License. You may obtain a copy of the GNU General Public License
 * Version 2 or later at the following locations:
 *
 * http://www.opensource.org/licenses/gpl-license.html
 * http://www.gnu.org/copyleft/gpl.html
 */

/ {
	description = "WBE2-DI-DR-3: digital inputs extension module";
	compatible-slots = "wbe2-gpio";

	fragment@0 {
		target-path = "/";

		__overlay__ {
			SLOT_DT_ALIAS(pinmux_dummy) {
				compatible = "regulator-fixed";
				regulator-name = EXPAND_AND_QUOTE(SLOT_DT_ALIAS(pimux_dummy));

				pinctrl-names = "default";
				pinctrl-0 = <SLOT_TXRX_GPIO_PINCTRL
							 SLOT_DE_GPIO_PINCTRL>;
			};
		};
	};

	
	fragment-gpio {
		target-path = "/wirenboard/gpios";

		__overlay__ {
			WBE_INPUT(IN1, TX, 1);
			WBE_INPUT(IN2, RX, 2);
			WBE_INPUT(IN3, RTS, 3);
		};
	};
};
