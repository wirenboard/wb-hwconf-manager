/*
 * Copyright 2016 Contactless Devices, LLC.
 *
 * The code contained herein is licensed under the GNU General Public
 * License. You may obtain a copy of the GNU General Public License
 * Version 2 or later at the following locations:
 *
 * http://www.opensource.org/licenses/gpl-license.html
 * http://www.gnu.org/copyleft/gpl.html
 */

/ {
	description = "WBE-I-KNX: KIMaip KNX interface module";
	compatible-slots = "wb5-mod";
	compatible = "contactless,imx28-wirenboard52";

	fragment@__COUNTER__ {
		target = <&SLOT_DT_ALIAS(pins)>;

		__overlay__ {
			fsl,pinmux-ids = <
				SLOT_PINMUX_I2C
				SLOT_PINMUX_GPIO(CS)
			>;
			fsl,drive-strength = <MXS_DRIVE_8mA>;
			fsl,voltage = <MXS_VOLTAGE_HIGH>;
			fsl,pull-up = <MXS_PULL_DISABLE>;
		};
	};

	#include "wbe-i2c.dtsi"
};
