/*
 * Copyright 2016 Contactless Devices, LLC.
 *
 * The code contained herein is licensed under the GNU General Public
 * License. You may obtain a copy of the GNU General Public License
 * Version 2 or later at the following locations:
 *
 * http://www.opensource.org/licenses/gpl-license.html
 * http://www.gnu.org/copyleft/gpl.html
 */

/ {
	description = "WBIO-DO-HS-8: High side switch I/O module";
	compatible-slots = "wb5-extio";
	
	#define WBIO_NAME wbio_do_hs_8
	#define WBIO_OUTPUT
	#define GPIO_LINE_NAMES \
			EXTIO_LINE_NAME(HS1), \
			EXTIO_LINE_NAME(HS2), \
			EXTIO_LINE_NAME(HS3), \
			EXTIO_LINE_NAME(HS4), \
			EXTIO_LINE_NAME(HS5), \
			EXTIO_LINE_NAME(HS6), \
			EXTIO_LINE_NAME(HS7), \
			EXTIO_LINE_NAME(HS8)

	#include "wbio.dtsi"

	fragment-gpio {
		target-path = "/wirenboard/gpios";

		__overlay__ {
			EXTIO_OUTPUT_HIGH(HS1, 0, 01);
			EXTIO_OUTPUT_HIGH(HS2, 1, 02);
			EXTIO_OUTPUT_HIGH(HS3, 2, 03);
			EXTIO_OUTPUT_HIGH(HS4, 3, 04);
			EXTIO_OUTPUT_HIGH(HS5, 4, 05);
			EXTIO_OUTPUT_HIGH(HS6, 5, 06);
			EXTIO_OUTPUT_HIGH(HS7, 6, 07);
			EXTIO_OUTPUT_HIGH(HS8, 7, 08);
		};
	};
};
