/*
 * Copyright 2016 Contactless Devices, LLC.
 *
 * The code contained herein is licensed under the GNU General Public
 * License. You may obtain a copy of the GNU General Public License
 * Version 2 or later at the following locations:
 *
 * http://www.opensource.org/licenses/gpl-license.html
 * http://www.gnu.org/copyleft/gpl.html
 */

/ {
	description = "WBE-MICROSD: microSD module (fast)";
	compatible-slots = "wb5-mod_mmc-4bit";
	compatible = "contactless,imx28-wirenboard52";

	fragment@0 {
		target = <SLOT_UART_ALIAS>;

		__overlay__ {
			status = "disabled";
		};
	};


	fragment@1 {
		target = <SLOT_MMC_ALIAS>;

		__overlay__ {
			compatible = "fsl,imx28-mmc";
			pinctrl-names = "default";
			pinctrl-0 = <SLOT_MMC_PINCTRL>;
			bus-width = <4>;
			status = "okay";
			broken-cd;
		};
	};
};
